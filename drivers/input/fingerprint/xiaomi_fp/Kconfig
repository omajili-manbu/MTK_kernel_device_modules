## drivers/misc/xiaomi/xr_qi/Kconfig
```kconfig
# SPDX-License-Identifier: GPL-2.0
config XIAOMI_XR_QI
	tristate "Xiaomi QoS inheritance provider"
	depends on ARM64 && ANDROID_VENDOR_HOOKS && ANDROID_VENDOR_OEM_DATA
	depends on XIAOMI_PERF_ACTUATOR && ANDROID_BINDER_IPC && CGROUPS && SMP && FUTEX
	depends on !PREEMPT_RT && !DEBUG_SPINLOCK && !DEBUG_LOCK_ALLOC
	depends on MUTEX_SPIN_ON_OWNER && RWSEM_SPIN_ON_OWNER
	help
	  Xiaomi QoS inheritance policy: binder/futex/lock QoS propagation and
	  QoS-gated spin budgets, driven by the /dev/xr_perf_actuator ABI and
	  native GKI lock/binder/futex vendor hooks. Feature 9 reuses the
	  native rwsem fast path; policy lives only in the hook decisions.
```

## drivers/thermal/xiaomi/Kconfig
```kconfig
config MI_THERMAL_INTERFACE
	tristate "Xiaomi thermal control interface"
	default n
	help
	  Xiaomi thermal control interface (mi_thermal_interface).

config MI_THERMAL_MULTI_CHARGE
	bool "Xiaomi thermal multi-charge usb online notify (rodin inline gate)"
	default n
	help
	  Device truth: blob strings carry usb_online / usb_online_work.

config MI_THERMAL_ATC_ENABLE
	bool "Xiaomi thermal ATC enable (rodin inline gate)"
	default n
	help
	  Device truth: blob strings carry atc_enable.
```
