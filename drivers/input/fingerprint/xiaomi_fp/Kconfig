## drivers/input/fingerprint/xiaomi_fp/Kconfig
```kconfig
config XIAOMI_SPI_TEE
	bool "Xiaomi fingerprint TEE driver (6.6 blob xiaomi_spi_tee.ko builtin)"
	help
	  Xiaomi fingerprint chardev/netlink driver (compatible
	  xiaomi,xiaomi-fp). Rebuilt from the rodin 6.6 blob
	  xiaomi_spi_tee.ko; gf_netlink_* and fp_* surface aligns the blob
	  symtab face.
```

## drivers/input/touchscreen/focaltech_rodin/Kconfig
```kconfig
# SPDX-License-Identifier: GPL-2.0-only
config TOUCHSCREEN_FOCALTECH_RODIN
	tristate "FocalTech touch driver for rodin"
	depends on TOUCHSCREEN_XIAOMI_TOUCH_RODIN
	default n
	help
	  FocalTech thp touch IC driver (focaltech_touch_rodin) built-in port.
	  SPI bus binding: compatible "xiaomi,touch-spi"; on rodin the
	  focaltech IC (FT5672) wins the probe race on this unit.
```

## drivers/input/touchscreen/goodix_brl_rodin/Kconfig
```kconfig
# SPDX-License-Identifier: GPL-2.0-only
config TOUCHSCREEN_GOODIX_BRL_RODIN
	tristate "Goodix BRL touch driver for rodin"
	depends on TOUCHSCREEN_XIAOMI_TOUCH_RODIN
	default n
	help
	  Goodix brl-series touch IC driver (goodix_core_rodin) built-in port.
	  SPI bus binding: compatible "xiaomi,touch-spi" competes with the
	  focaltech rodin driver; first probed driver claims the device
	  (stock 6.6 behavior, per-unit IC population decides the winner).
```

## drivers/input/touchscreen/xiaomi_touch_rodin/Kconfig
```kconfig
# SPDX-License-Identifier: GPL-2.0-only
config TOUCHSCREEN_XIAOMI_TOUCH_RODIN
	tristate "Xiaomi touch framework driver for rodin"
	default n
	help
	  Xiaomi touch framework (xiaomi_touch_rodin) built-in port for the
	  rodin device. =y built-in per the rodin builtin policy; the 6.6
	  stock blob (vendor_dlkm/xiaomi_touch_rodin.ko) is answered success
	  by the skip loader.

config TOUCHSCREEN_XIAOMI_TOUCH_RODIN_DEBUG
	bool "xiaomi_touch_rodin debug features"
	depends on TOUCHSCREEN_XIAOMI_TOUCH_RODIN
	default n
	help
	  Stock blob gate equivalent for debug-only code paths.
```

## drivers/memory/xiaomi/Kconfig
```kconfig
config XIAOMI_MI_MEMORY
	bool "Xiaomi mi memory info (6.6 blob mi_memory.ko builtin)"
	depends on SCSI_UFSHCD
	help
	  Xiaomi memory info provider (proc /proc/mv, /sys/class/mi_memory).
	  Rebuilt from the rodin 6.6 blob mi_memory.ko; UFS ABI surface is
	  provided by drivers/ufs/vendor/ufs-xiaomi.c.
```

## drivers/misc/hwid/Kconfig
```kconfig
# SPDX-License-Identifier: GPL-2.0
config HWID
	tristate "Xiaomi HwId Module Driver"
	default n
	help
	  HwId Module driver for mi driver acquire some hwid build info,
	  which is only used for xiaomi corporation internally.
	  rodin: =y 内建（T2②，blob 合并代九处对齐重建）；dash 两树无源，
	  门为 rodin 侧补写（T1 mi_log/mi_mem_engine 同款）。
```

## drivers/misc/mediatek/aee/Kconfig
```kconfig
config MTK_AEE_FEATURE
	tristate "Enable Android Exception Enhancement"
	select FIQ_GLUE if !TRUSTONIC_TEE_SUPPORT && !ARM_PSCI && !TRUSTY
	select FTRACE
	help
	  AEE (Android Exception Engine) that designed by  Mediatek is an
	  exception catching and debugging information generation mechanism.
	  It can collect and dump information to filesystem
	  (/sdcard/mtklog/aee_exp)  when exceptions occur(E.g. kernel
	  panic/android system server crash and ..)

config MTK_AEE_AED
	tristate "Enable AEE Kernel Exception Report Daemon"
	depends on MTK_AEE_FEATURE
	help
	  MTK_AEE_AED is the kernel config of aed, which is the base support for
	  aee features. Such as:
	  aed debug: some test case for aee driver itself
	  aed main: aed main function and ioctl for user space aee
	  monitor hang: detect hang feature...

config MTK_AEE_IPANIC
	tristate "Enable AEE Kernel Panic Dump"
	depends on MTK_AEE_FEATURE
	help
	  MTK_AEE_IPANIC is the kernel config of ipanic feature designed by
	  MTK, which is the enhancement of kernel defaut panic flow, and
	  combined with aee. It will do some hook function and get some
	  kernel panic information for debug.

config MTK_AEE_RAM_CONSOLE
	bool "Enable AEE RAM console (SYS_LAST_KMSG ring)"
	depends on MTK_AEE_IPANIC
	default n
	help
	  Register the AEE mboot_params "ram" console even when PSTORE is
	  enabled. Every kernel console write is mirrored into the 128 KiB
	  mbootlog ring, which is included in the mrdump mini dump. Unlike
	  pstore (overwritten on the next boot), this keeps the dying boot
	  last kernel messages across a WDT/hang reset.

config MTK_AEE_HANGDET
	tristate "Enable AEE Kernel Hang Detector"
	depends on MTK_AEE_FEATURE
	help
	  MTK_AEE_HANGDET is the kernel config of hang detector feature
	  designed by MTK, which is the mechanism to check if each cpu
	  is alived. When cpu hang is detected, raise excetpion.
	  Avoid system_server is blocked.

config MTK_AEE_HANGDET_IMPROVE_PERFORMANCE
	tristate "Improve Performance of Hang Detector"
	depends on MTK_AEE_HANGDET
	default no
	help
	  MTK_AEE_HANGDET_IMPROVE_PERFORMANCE is the kernel config of hang
	  detector feature designed by MTK, which is intended to reduce the
	  execution time of the hang detector during normal kicks, especially
	  under high system performance conditions.

config MTK_AVOID_TRUNCATE_COREDUMP
	tristate "Enable AEE coredump and signal enhance patch"
	help
	  MTK_AVOID_TRUNCATE_COREDUMP is the kernel config, avoid truncating
	  coredump after receiving signal 9. And ensure coredump file is complete
	  when occurring suspend issue. Beyond that, it will avoid task race condition
	  issue after NE task early exit, which will cause aed KE issue.

config MTK_PANIC_ON_WARN
	tristate "Enable warning as panic"
	help
	  MTK_PANIC_ON_WARN is the kernel config of warning as panic.
	  help us catch more exception.

 config MTK_AEE_UT
	tristate "control AED debug file"
	help
	  MTK_AEE_UT is the kernel config of aed-debug.c
	  aed-debug.c is AEE UT test case file, just for generate some vendor
	  exception to test AEE dump flow, include in KE, HWT, HW_reboot, EE,
	  and kernelAPI exception

config MTK_AEE_YOCTO
	bool "AED runs on the Yocto system"
	help
	  MTK_AEE_YOCTO is the kernel config of designed by MTK,
	  The AED is specified to run on the Yocto system, and
          the paths for AED-related binaries on the Yocto system
          are different from those on the Android system. aee
          driver needs to distinguish whether the current system
          is Yocto.
```

## drivers/misc/mediatek/mminfra/Kconfig
```kconfig
# SPDX-License-Identifier: GPL-2.0

config MTK_MMINFRA
	tristate "MediaTek MMInfra driver"
	depends on ARCH_MEDIATEK || COMPILE_TEST
	help
	  This driver is for the Multimedia Infrastructure in MediaTek SoCs.
	  The MMINFRA driver mainly help control power, clock and security setting
	  for the bus of multimedia users, such as display, camera, mdp and video
	  codec. The MMINFRA driver also provide backup and restore function for
	  registers located in the same power domain.

config MTK_MMINFRA_DEBUG
	tristate "MediaTek MMInfra driver debug"
	depends on MTK_MMINFRA
	help
	  This extension enables debug features for MMINFRA driver. We only default
	  enable this in userdebug/eng load. With this extension enabled, you
	  can use adb command to dynamically do MMINFRA debug items. This extension
	  is by default disabled on user load for security concern.

config MTK_MMINFRA_DEBUG_STACK
	bool "mminfra debug/imax stack (rodin: scoped out of builtin batch 2)"
	default n
	help
	  rodin r25: mm-fake-engine builds builtin under MTK_MMINFRA, while
	  mtk-mminfra-debug/imax stay behind this switch until their smmu-v3
	  header chain is ported to 6.18. Default n keeps them as blobs.
```

## drivers/misc/mediatek/performance/Kconfig
```kconfig
config MTK_FPSGO_V3
	tristate "Support FPSGO_V3 framework"
	help
	  Support FPSGO_V3 framework for most FPS performance and
	  low power balance. As a perquisite to ensure FPS performance,
	  FPSGO_V3 persuades lowest power consumption for better DoU
	  endurance and gaming experience.
	  FPSGO_V3 include AI performance and low power.
	  If you are not sure about this, set n.

config MTK_PERFORMANCE_MODULE
	tristate "Mediatek Performance Module"
	help
	  For MediaTek performance modules, such as FPSGO and EARA-QoS
	  Select "y" if you want to enable power throttling feature
	  Select "n" if unsure.

config MTK_FRS
	tristate "Mediatek Frame Rate Smoother"
	depends on MTK_FPSGO_V3
	help
	  Support Frame Rate Smoother kernel intergface. It will adjustment
	  target fps by thermal.
	  If you are not sure about this, set n.




config MTK_GAME
	tristate "GAME module specific"
	help
	  MTK game module, in order to decouple with FPSGO module
	  This module is for game feature use, If some flow modification
	  for game only, need to modify in this module.
	  Default it enable on eng, user, userdebug load.
```

## drivers/misc/xiaomi/Kconfig
```kconfig
# SPDX-License-Identifier: GPL-2.0-only
#
# Misc memory devices
#

menu "Xiaomi Misc devices"
source "$(KCONFIG_EXT_PREFIX)drivers/misc/xiaomi/build_product_name/Kconfig"
endmenu
source "$(KCONFIG_EXT_PREFIX)drivers/misc/xiaomi/metis/Kconfig"
source "$(KCONFIG_EXT_PREFIX)drivers/misc/xiaomi/mi_schedule/Kconfig"
source "$(KCONFIG_EXT_PREFIX)drivers/misc/xiaomi/xr_qi/Kconfig"
source "$(KCONFIG_EXT_PREFIX)drivers/misc/xiaomi/perf_actuator/Kconfig"
```

## drivers/misc/xiaomi/bootmonitor/Kconfig
```kconfig
# SPDX-License-Identifier: GPL-2.0
config XIAOMI_BOOTMONITOR
	tristate "Xiaomi boot monitor"
	depends on MTPROF
	default n
	help
	  Xiaomi boot-time monitor: follows the boot stage sequence recorded
	  by the bootprof logger, keeps a per-stage timeout/error ledger and
	  dumps the ramoops pmsg console plus the bootprof log into the
	  blackbox partition when the unit boots after a boot failure.

	  rodin: blob(6.6 bootmonitor.ko) 反汇编等价重建后 =y 内建；消费
	  bootprof 三件导出（bootprof_lock/get_log_count/get_bootprof_pointer），
	  故依赖 MTPROF。
```

## drivers/misc/xiaomi/lb/Kconfig
```kconfig
# SPDX-License-Identifier: GPL-2.0-only
config XIAOMI_LB
	tristate "Xiaomi launch boost page recorder"
	depends on ARM64 && ARM64_4K_PAGES && MMU && SWAP && PROC_FS && ANDROID_VENDOR_HOOKS
	help
	  Stock launch boost interface, file-page collection and cold-start
	  package recording behind /dev/iorap_dev (rodin blob 6.6.77-android15,
	  cold face only - no PTE snapshot/preread engine). Stock defects are
	  deliberately retained; changing behavior breaks the iorapd contract.
```

## drivers/misc/xiaomi/metis/Kconfig
```kconfig
# SPDX-License-Identifier: GPL-2.0-only
config XIAOMI_METIS
	tristate "Xiaomi METIS stock reconstruction (6.18 aligned)"
	depends on ARM64 && ANDROID_VENDOR_HOOKS && ANDROID_VENDOR_OEM_DATA
	default n
	help
	  Xiaomi METIS fully aligned to the CCC dash reconstruction
	  (OS3.0.305 stock): VIP/lock-inheritance marking, cold-start
	  protection, cluster affinity/frequency boost, pick-side policy
	  libraries, WALT/deadline/schlat/io/lowlt faces and the registry
	  provider slots, all attached to the live 6.18 GKI vendor-hook
	  surface. Closed-scheduler-only entry bridges (stock-context
	  assembly) are kept compiled but dormant, matching upstream dash.
	  Carrier state lives in the mi_schedule task slots. Stock defects
	  are retained except where the 6.18 environment forbids them
	  (mutex oem payload co-tenancy with xr_qi, record_*_starttime
	  hook absence, set_next_entity signature drift).
```

## drivers/misc/xiaomi/mi_exception_log/Kconfig
```kconfig
config MI_EXCEPTION_LOG
	bool "Xiaomi exception log device (6.6 blob mi_exception_log.ko builtin)"
	help
	  /dev/mi_exception_log ring buffer for AIS exception logs. Rebuilt
	  from the rodin 6.6 blob mi_exception_log.ko.
```

## drivers/misc/xiaomi/mi_mempool/Kconfig
```kconfig
config MI_MEMPOOL
	tristate "MI_MEMPOOL page reserve pool (rodin blob rebuild)"
	default n
	help
	  Preserve page pools served to whitelisted core processes on memory
	  allocation failures or direct-reclaim throttle.  Rebuilt against the
	  rodin device blob; sysfs: /sys/kernel/mi_mempool/{pids,config,
	  direct_reclaim_threshold_mb,general_stat_info,process_use_count}.
```

## drivers/misc/xiaomi/mi_schedule/Kconfig
```kconfig
# SPDX-License-Identifier: GPL-2.0
config XIAOMI_MI_SCHEDULE
	tristate "Xiaomi task-state carrier (slots, cluster type, 32B uid map)"
	depends on ARM64 && ANDROID_VENDOR_HOOKS && ANDROID_VENDOR_OEM_DATA
	help
	  Per-task state carrier for the Xiaomi policy modules: mi_task_struct
	  slots in the GKI task tail, cluster typing from the native topology
	  masks, and the 32-bit compat UID map. Fork production attaches to
	  the native android_rvh_sched_fork; free/cleanup to
	  android_vh_free_task. The stock per-UID runtime accounting and
	  /proc/package faces are dropped: 6.18 owns load tracking
	  (PELT/schedstat), and their producers were closed-scheduler calls.
```

## drivers/misc/xiaomi/migt/Kconfig
```kconfig
# SPDX-License-Identifier: GPL-2.0
config XIAOMI_MIGT
	tristate "Xiaomi MiGameTurbo (6.18 aligned)"
	depends on ARM64 && ANDROID_VENDOR_HOOKS && ANDROID_VENDOR_OEM_DATA
	select XIAOMI_METIS
	default n
	help
	  Xiaomi MIGT game scheduling/frequency policy, aligned to the CCC
	  dash reconstruction (OS3.0.305 stock). Providers that stock
	  resolved in the closed scheduler are rebuilt: the game_migt slot
	  family and oem_freq live in metis (with 6.18 vendor-hook
	  bridges), sched_load_update in mi_schedule. Stock parameter
	  defaults keep every policy gate off until userspace opts in.
```

## drivers/misc/xiaomi/minet/Kconfig
```kconfig
# SPDX-License-Identifier: GPL-2.0-only
config MINET
	tristate "Xiaomi minet flow monitor and idle notifications"
	depends on NETFILTER && NF_CONNTRACK && INET && IPV6
	depends on PM_SLEEP && ANDROID_VENDOR_OEM_DATA
	help
	  Reconstructs the stock minet Generic Netlink, flow accounting and
	  wlan0 idle notification contracts (rodin blob 6.6.77-android15).
	  Stock defects are deliberately retained; changing behavior breaks
	  the userspace minetd contract.
```

## drivers/misc/xiaomi/miwill/Kconfig
```kconfig
# SPDX-License-Identifier: GPL-2.0-only
config XIAOMI_MIWiLL
	tristate "Xiaomi MiWiLL virtual network device"
	depends on NET && INET && IPV6 && NETFILTER
	default n
	help
	  Stock MiWiLL virtual network device with its embedded application
	  flow monitor, rebuilt against the rodin vendor_dlkm 6.6.77 blob
	  (vendor_dlkm modules.load line 240).  Log face, extack texts and
	  the miwill_cnt parameter follow the blob generation; minetd
	  resolves the miwill_genl family through this device.

config XIAOMI_MIWiLL_REDUDANCY
	tristate "Xiaomi MiWiLL redudancy mode"
	depends on XIAOMI_MIWiLL
	default n
	help
	  Stock redudancy mode module rebuilt against the same blob
	  (modules.load line 241, depends = miwill, zero module params).
	  It carries only its private mode ops and registers them with
	  the framework exported by XIAOMI_MIWiLL.
```

## drivers/misc/xiaomi/scene_swappiness/Kconfig
```kconfig
config SCENE_SWAPPINESS
	bool "Xiaomi scene swappiness vendor hook (6.6 blob scene_swappiness.ko builtin)"
	help
	  Registers the android_vh_tune_swappiness vendor hook and the
	  /proc/mi_mem_swappiness/swappiness_para control. Rebuilt from the
	  rodin 6.6 blob scene_swappiness.ko.
```

## drivers/misc/xiaomi/simtray/Kconfig
```kconfig
config XIAOMI_SIMTRAY
	bool "Xiaomi SIM tray status driver (6.6 blob simtray.ko builtin)"
	depends on GPIOLIB
	help
	  Xiaomi SIM/SD card tray insertion and extraction monitoring.
	  Rebuilt from the rodin 6.6 blob simtray.ko (compatible
	  xiaomi,simtray-status).
```
